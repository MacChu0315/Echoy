## main/Kconfig.projbuild
```kconfig
menu "Echoy"
    config ECHOY_DEV_INJECTION
        bool "Enable development-only Echoy event injection RPCs"
        default n
        help
            Enables service 0xec01 methods 2-4 for local testing. Ordinary
            application builds register only the read-only snapshot method.
    config ECHOY_DEFAULT_ENGLISH
        bool "Use English before application settings have been saved"
        default n
endmenu
```

## projects/echoy/main/Kconfig.projbuild
```kconfig
menu "Echoy diagnostic build"

    config ECHOY_PREBUILT_AUDIO
        bool "Generate fixed cues and audition phrases at build time"
        default y
        help
            Use the production C synthesizer on the build host and embed its
            float32 output with the selected device/office profile. Startup
            validates and copies it to owned PSRAM buffers. Recorded phrases
            are still synthesized on the background worker. Disable only for
            reference comparisons; this does not change stored user data.

    config ECHOY_VERIFY_PREBUILT_AUDIO
        bool "Compare fixed assets against on-device synthesis at startup"
        depends on ECHOY_PREBUILT_AUDIO
        default n
        help
            Diagnostic build only. Re-synthesizes each cue and role before PCM
            activation, compares samples and onset bounds, and rejects errors
            above 1e-5 absolute/relative L2. Intentionally delays startup.
            Keep disabled for normal builds and startup timing measurements.

    config ECHOY_PHRASE_PICKUP
        bool "Add the auditioned local phrase pickup"
        default y
        help
            Add 1-2 quiet lead-in notes only to local playback and artwork.
            Disable for original-algorithm PCM regression. Relationship plans,
            recording and the office speaker profile are unchanged.
config ECHOY_MAGNET_DIAGNOSTICS
    bool "Enable read-only magnetic/link snapshots and rejected-startup logs"
    default n
    help
        Link-worker-only readback of both successful BMM150 compensated outputs
        and exact INT16_MIN sentinel bits. Logs at most three startup windows.
        Read-only ECA1 method 4 returns a nonblocking cache of the latest sample,
        filtered axes, contact masks and admitted neighbors. No query reads I2C.
        Does not change sensor settings, classification, retries, UI, sound or
        playback permission. Keep disabled in accepted release builds.
config ECHOY_AUDIO_DIAGNOSTICS
    bool "Enable explicit audio readback and one-second reference-tone RPC"
    default n
    help
        Adds private ESP-Iris service 0xECA0 for controlled device bring-up.
        Never plays automatically. Method 1 reads cached state, 2 requests a
        fixed one-second 1 kHz tone, and 3 cancels it. Music is paused and never
        resumed automatically. Keep disabled in normal product builds.
config ECHOY_OUTPUT_MEASUREMENT
    bool "Enable explicitly authorized bounded microphone/output measurement"
    depends on !ECHOY_AUDIO_DIAGNOSTICS
    default n
    help
        Temporary private service 0xECA2. Explicit start only, fixed 10.5-second
        speaker test and microphone capture, with a 12-second deadline and at
        most two starts per boot. The host also enforces the consent budget
        across boots. Pause cancels; completion never resumes music. Keep
        disabled in ordinary builds. Enabling this is not capture consent.
endmenu

menu "Echoy device audio trials"
config ECHOY_HARMONY_BASS_TRIAL
    bool "Apply the approved 500 Hz Harmony bass-cut trial to prepared loops"
    depends on !ECHOY_OFFICE_VOICING_TRIAL
    default n
    help
        Filters only the normalized Harmony FULL loop before the existing role
        gain. Runs during background sound preparation, never on the PCM owner.
        Other roles, notes, timing, UI volume and the .60 output ceiling remain
        unchanged. No gain compensation and no microphone capture. Keep off
        for ordinary releases until physical listening acceptance is complete.
config ECHOY_OFFICE_VOICING_TRIAL
    bool "Apply the approved office speaker-voicing trial to prepared loops"
    default n
    help
        Applies the office listening trial to the prepared loops of all roles,
        followed by its separate role-gain table. The office helper includes
        the Harmony bass cut, so the older Harmony-only trial cannot also run.
        Runs only on the background preparation worker. Notes, timing, playback
        permission, UI volume and the .60 output ceiling remain unchanged.
        Does not enable microphone capture or reference-tone diagnostics.
        Keep disabled in ordinary releases pending physical acceptance.
endmenu
```
